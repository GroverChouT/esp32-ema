## main/Kconfig.projbuild
```kconfig
menu "Configuration"
    config ESP_WIFI_SSID
        string "WiFi SSID"
        default "SSID"
        help
            SSID (network name) to connect to.

    config ESP_WIFI_PASSWORD
        string "WiFi Password"
        default "PASSWORD"
        help
            WiFi password (WPA or WPA2).

    config ESP_MAXIMUM_RETRY
        int "Maximum retry"
        default 5
        help
            Set the Maximum retry to avoid station reconnecting to the AP unlimited when the AP is really inexistent.

    config BROKER_URL
        string "Broker URL"
        default "mqtt://mqtt.eclipseprojects.io"
        help
            URL of the broker to connect to
endmenu
```
